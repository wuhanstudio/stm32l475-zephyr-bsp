## CMakeLists.txt
```
# SPDX-License-Identifier: Apache-2.0

cmake_minimum_required(VERSION 3.20.0)

find_package(Zephyr REQUIRED HINTS $ENV{ZEPHYR_BASE})
project(hello_world)

target_sources(app PRIVATE src/main.c src/fill_buf.c)
```

## prj.conf
```kconfig
CONFIG_I2C=y
CONFIG_HW_STACK_PROTECTION=y
CONFIG_GPIO=y
CONFIG_CONSOLE=y
CONFIG_ARM_MPU=y
# CONFIG_INIT_STACKS is not set
# CONFIG_THREAD_MONITOR is not set
# CONFIG_THREAD_NAME is not set
CONFIG_HEAP_MEM_POOL_SIZE=8192
# CONFIG_DEVICE_DT_METADATA is not set
CONFIG_UART_CONSOLE=y
CONFIG_DISPLAY=y
CONFIG_GPIO_SHELL=y
CONFIG_I2C_SHELL=y
CONFIG_SPI_SHELL=y
CONFIG_SHELL=y
```

## boards/pandora_stm32l475.overlay
```dts
&i2c3 {
	compatible = "st,stm32-i2c-v2";
	pinctrl-0 = <&i2c3_scl_pc0 &i2c3_sda_pc1>;
	pinctrl-names = "default";
	clock-frequency = <I2C_BITRATE_STANDARD>;
	status = "okay";
};

&spi3 {
	status = "okay";

	pinctrl-0 = <&spi3_sck_pb3 &spi3_miso_pb4 &spi3_mosi_pb5>;
	pinctrl-names = "default";

	cs-gpios = <&gpiod 7 GPIO_ACTIVE_LOW>;
};
```

## src/main.c
```c
/*
 * Copyright (c) 2019 Jan Van Winkel <jan.van_winkel@dxplore.eu>
 *
 * Based on ST7789V sample:
 * Copyright (c) 2019 Marc Reilly
 *
 * SPDX-License-Identifier: Apache-2.0
 */

#include <stdio.h>

#include <zephyr/logging/log.h>
LOG_MODULE_REGISTER(sample, LOG_LEVEL_INF);
#include <zephyr/drivers/gpio.h>

#include "fill_buf.h"
#define LED0_NODE DT_ALIAS(led0) 
static const struct gpio_dt_spec led = GPIO_DT_SPEC_GET(LED0_NODE, gpios);

static inline void fill_buffer_mono01(enum corner corner, uint8_t grey,
                      uint8_t *buf, size_t buf_size)
{
    fill_buffer_mono(corner, grey, 0x00u, 0xFFu, buf, buf_size);
}

static inline void fill_buffer_mono10(enum corner corner, uint8_t grey,
                      uint8_t *buf, size_t buf_size)
{
    fill_buffer_mono(corner, grey, 0xFFu, 0x00u, buf, buf_size);
}

int main(void)
{
    size_t x;
    size_t y;
    size_t rect_w;
    size_t rect_h;
    size_t h_step;
    size_t scale;
    size_t grey_count;
    uint8_t bg_color;
    uint8_t *buf;
    int32_t grey_scale_sleep;
    const struct device *display_dev;
    struct display_capabilities capabilities;
    struct display_buffer_descriptor buf_desc;
    size_t buf_size = 0;

    fill_buffer fill_buffer_fnc = NULL;

    display_dev = DEVICE_DT_GET(DT_CHOSEN(zephyr_display));
    if (!device_is_ready(display_dev)) {
        LOG_ERR("Device %s not found. Aborting sample.",
            display_dev->name);
    }

    LOG_INF("Display sample for %s", display_dev->name);
    display_get_capabilities(display_dev, &capabilities);

    if (capabilities.screen_info & SCREEN_INFO_MONO_VTILED) {
        rect_w = 16;
        rect_h = 8;
    } else {
        rect_w = 2;
        rect_h = 1;
    }

    if ((capabilities.x_resolution < 3 * rect_w) ||
        (capabilities.y_resolution < 3 * rect_h) ||
        (capabilities.x_resolution < 8 * rect_h)) {
        rect_w = capabilities.x_resolution * 40 / 100;
        rect_h = capabilities.y_resolution * 40 / 100;
        h_step = capabilities.y_resolution * 20 / 100;
        scale = 1;
    } else {
        h_step = rect_h;
        scale = (capabilities.x_resolution / 8) / rect_h;
    }

    rect_w *= scale;
    rect_h *= scale;

    if (capabilities.screen_info & SCREEN_INFO_EPD) {
        grey_scale_sleep = 10000;
    } else {
        grey_scale_sleep = 100;
    }

    buf_size = rect_w * rect_h;

    if (buf_size < (capabilities.x_resolution * h_step)) {
        buf_size = capabilities.x_resolution * h_step;
    }

    switch (capabilities.current_pixel_format) {
        case PIXEL_FORMAT_ARGB_8888:
            bg_color = 0xFFu;
            fill_buffer_fnc = fill_buffer_argb8888;
            buf_size *= 4;
            break;
        case PIXEL_FORMAT_RGB_888:
            bg_color = 0xFFu;
            fill_buffer_fnc = fill_buffer_rgb888;
            buf_size *= 3;
            break;
        case PIXEL_FORMAT_RGB_565:
            bg_color = 0xFFu;
            fill_buffer_fnc = fill_buffer_rgb565;
            buf_size *= 2;
            break;
        case PIXEL_FORMAT_BGR_565:
            bg_color = 0xFFu;
            fill_buffer_fnc = fill_buffer_bgr565;
            buf_size *= 2;
            break;
        case PIXEL_FORMAT_MONO01:
            bg_color = 0xFFu;
            fill_buffer_fnc = fill_buffer_mono01;
            buf_size = DIV_ROUND_UP(DIV_ROUND_UP(
                buf_size, NUM_BITS(uint8_t)), sizeof(uint8_t));
            break;
        case PIXEL_FORMAT_MONO10:
            bg_color = 0x00u;
            fill_buffer_fnc = fill_buffer_mono10;
            buf_size = DIV_ROUND_UP(DIV_ROUND_UP(
                buf_size, NUM_BITS(uint8_t)), sizeof(uint8_t));
            break;
        default:
            LOG_ERR("Unsupported pixel format. Aborting sample.");
			return 1;
    }

    buf = k_malloc(buf_size);

    if (buf == NULL) {
        LOG_ERR("Could not allocate memory. Aborting sample.");
		return 1;
    }

    (void)memset(buf, bg_color, buf_size);

    buf_desc.buf_size = buf_size;
    buf_desc.pitch = capabilities.x_resolution;
    buf_desc.width = capabilities.x_resolution;
    buf_desc.height = h_step;

    for (int idx = 0; idx < capabilities.y_resolution; idx += h_step) {
        /*
         * Tweaking the height value not to draw outside of the display.
         * It is required when using a monochrome display whose vertical
         * resolution can not be divided by 8.
         */
        if ((capabilities.y_resolution - idx) < h_step) {
            buf_desc.height = (capabilities.y_resolution - idx);
        }
        display_write(display_dev, 0, idx, &buf_desc, buf);
    }

    buf_desc.pitch = rect_w;
    buf_desc.width = rect_w;
    buf_desc.height = rect_h;

    fill_buffer_fnc(TOP_LEFT, 0, buf, buf_size);
    x = 0;
    y = 0;
    display_write(display_dev, x, y, &buf_desc, buf);

    fill_buffer_fnc(TOP_RIGHT, 0, buf, buf_size);
    x = capabilities.x_resolution - rect_w;
    y = 0;
    display_write(display_dev, x, y, &buf_desc, buf);

    fill_buffer_fnc(BOTTOM_RIGHT, 0, buf, buf_size);
    x = capabilities.x_resolution - rect_w;
    y = capabilities.y_resolution - rect_h;
    display_write(display_dev, x, y, &buf_desc, buf);

	gpio_pin_configure_dt(&led, GPIO_OUTPUT);
	gpio_pin_set(led.port, led.pin, 1);

    display_blanking_off(display_dev);

    grey_count = 0;
    x = 0;
    y = capabilities.y_resolution - rect_h;

    while (1) {
        fill_buffer_fnc(BOTTOM_LEFT, grey_count, buf, buf_size);
        display_write(display_dev, x, y, &buf_desc, buf);

        ++grey_count;

        k_msleep(grey_scale_sleep);
        // printf("Grey Count %d \n", grey_count);
    }

    return 0;
}
```

## src/fill_buf.c
```c
#include "fill_buf.h"

void fill_buffer_argb8888(enum corner corner, uint8_t grey, uint8_t *buf,
                 size_t buf_size)
{
    uint32_t color = 0;

    switch (corner) {
    case TOP_LEFT:
        color = 0x00FF0000u;
        break;
    case TOP_RIGHT:
        color = 0x0000FF00u;
        break;
    case BOTTOM_RIGHT:
        color = 0x000000FFu;
        break;
    case BOTTOM_LEFT:
        color = grey << 16 | grey << 8 | grey;
        break;
    }

    for (size_t idx = 0; idx < buf_size; idx += 4) {
        *((uint32_t *)(buf + idx)) = color;
    }
}

void fill_buffer_rgb888(enum corner corner, uint8_t grey, uint8_t *buf,
                   size_t buf_size)
{
    uint32_t color = 0;

    switch (corner) {
    case TOP_LEFT:
        color = 0x00FF0000u;
        break;
    case TOP_RIGHT:
        color = 0x0000FF00u;
        break;
    case BOTTOM_RIGHT:
        color = 0x000000FFu;
        break;
    case BOTTOM_LEFT:
        color = grey << 16 | grey << 8 | grey;
        break;
    }

    for (size_t idx = 0; idx < buf_size; idx += 3) {
        *(buf + idx + 0) = color >> 16;
        *(buf + idx + 1) = color >> 8;
        *(buf + idx + 2) = color >> 0;
    }
}

uint16_t get_rgb565_color(enum corner corner, uint8_t grey)
{
    uint16_t color = 0;
    uint16_t grey_5bit;

    switch (corner) {
    case TOP_LEFT:
        color = 0xF800u;
        break;
    case TOP_RIGHT:
        color = 0x07E0u;
        break;
    case BOTTOM_RIGHT:
        color = 0x001Fu;
        break;
    case BOTTOM_LEFT:
        grey_5bit = grey & 0x1Fu;
        /* shift the green an extra bit, it has 6 bits */
        color = grey_5bit << 11 | grey_5bit << (5 + 1) | grey_5bit;
        break;
    }
    return color;
}

void fill_buffer_rgb565(enum corner corner, uint8_t grey, uint8_t *buf,
                   size_t buf_size)
{
    uint16_t color = get_rgb565_color(corner, grey);

    for (size_t idx = 0; idx < buf_size; idx += 2) {
        *(buf + idx + 0) = (color >> 8) & 0xFFu;
        *(buf + idx + 1) = (color >> 0) & 0xFFu;
    }
}

void fill_buffer_bgr565(enum corner corner, uint8_t grey, uint8_t *buf,
                   size_t buf_size)
{
    uint16_t color = get_rgb565_color(corner, grey);

    for (size_t idx = 0; idx < buf_size; idx += 2) {
        *(uint16_t *)(buf + idx) = color;
    }
}

void fill_buffer_mono(enum corner corner, uint8_t grey,
                 uint8_t black, uint8_t white,
                 uint8_t *buf, size_t buf_size)
{
    uint16_t color;

    switch (corner) {
    case BOTTOM_LEFT:
        color = (grey & 0x01u) ? white : black;
        break;
    default:
        color = black;
        break;
    }

    memset(buf, color, buf_size);
}
```

## src/lvgl_sample.c
```c
#include <lvgl.h>

static lv_obj_t * meter;

static void set_value(void * indic, int32_t v)
{
    lv_meter_set_indicator_end_value(meter, indic, v);
}

/**
 * A meter with multiple arcs
 */
static void lv_example_meter_2(void)
{
    meter = lv_meter_create(lv_scr_act());
    lv_obj_center(meter);
    lv_obj_set_size(meter, 200, 200);

    /*Remove the circle from the middle*/
    lv_obj_remove_style(meter, NULL, LV_PART_INDICATOR);

    /*Add a scale first*/
    lv_meter_scale_t * scale = lv_meter_add_scale(meter);
    lv_meter_set_scale_ticks(meter, scale, 11, 2, 10, lv_palette_main(LV_PALETTE_GREY));
    lv_meter_set_scale_major_ticks(meter, scale, 1, 2, 30, lv_color_hex3(0xeee), 15);
    lv_meter_set_scale_range(meter, scale, 0, 100, 270, 90);

    /*Add a three arc indicator*/
    lv_meter_indicator_t * indic1 = lv_meter_add_arc(meter, scale, 10, lv_palette_main(LV_PALETTE_RED), 0);
    lv_meter_indicator_t * indic2 = lv_meter_add_arc(meter, scale, 10, lv_palette_main(LV_PALETTE_GREEN), -10);
    lv_meter_indicator_t * indic3 = lv_meter_add_arc(meter, scale, 10, lv_palette_main(LV_PALETTE_BLUE), -20);

    /*Create an animation to set the value*/
    lv_anim_t a;
    lv_anim_init(&a);
    lv_anim_set_exec_cb(&a, set_value);
    lv_anim_set_values(&a, 0, 100);
    lv_anim_set_repeat_delay(&a, 100);
    lv_anim_set_playback_delay(&a, 100);
    lv_anim_set_repeat_count(&a, LV_ANIM_REPEAT_INFINITE);

    lv_anim_set_time(&a, 2000);
    lv_anim_set_playback_time(&a, 500);
    lv_anim_set_var(&a, indic1);
    lv_anim_start(&a);

    lv_anim_set_time(&a, 1000);
    lv_anim_set_playback_time(&a, 1000);
    lv_anim_set_var(&a, indic2);
    lv_anim_start(&a);

    lv_anim_set_time(&a, 1000);
    lv_anim_set_playback_time(&a, 2000);
    lv_anim_set_var(&a, indic3);
    lv_anim_start(&a);
}

void lv_sample(void)
{
    lv_example_meter_2();
}
```
