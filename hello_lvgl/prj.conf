## CMakeLists.txt
```
# SPDX-License-Identifier: Apache-2.0

cmake_minimum_required(VERSION 3.20.0)

find_package(Zephyr REQUIRED HINTS $ENV{ZEPHYR_BASE})
project(hello_world)

target_sources(app PRIVATE src/main.c src/lvgl_sample.c)
```

## prj.conf
```kconfig
CONFIG_LV_Z_VDB_SIZE=32
CONFIG_LV_Z_BITS_PER_PIXEL=16
CONFIG_I2C=y
CONFIG_MAIN_STACK_SIZE=2048
CONFIG_HW_STACK_PROTECTION=y
CONFIG_GPIO=y
CONFIG_CONSOLE=y
CONFIG_LV_CONF_MINIMAL=y
CONFIG_LV_USE_METER=y
CONFIG_LV_USE_THEME_DEFAULT=y
CONFIG_LV_THEME_DEFAULT_DARK=y
CONFIG_LVGL=y
CONFIG_LV_Z_MEM_POOL_SIZE=8192
CONFIG_ARM_MPU=y
# CONFIG_INIT_STACKS is not set
# CONFIG_THREAD_MONITOR is not set
# CONFIG_THREAD_NAME is not set
CONFIG_HEAP_MEM_POOL_SIZE=8192
# CONFIG_DEVICE_DT_METADATA is not set
CONFIG_UART_CONSOLE=y
CONFIG_DISPLAY=y
CONFIG_GPIO_SHELL=y
CONFIG_I2C_SHELL=y
CONFIG_SPI_SHELL=y
CONFIG_SHELL=y
```

## src/main.c
```c
/*
 * Copyright (c) 2012-2014 Wind River Systems, Inc.
 *
 * SPDX-License-Identifier: Apache-2.0
 */

#include <stdio.h>
#include <string.h>

#include <zephyr/kernel.h>
#include <zephyr/device.h>
#include <zephyr/drivers/display.h>
#include <zephyr/drivers/gpio.h>

#include <lvgl.h>
#include "lvgl_sample.h"

#define LED0_NODE DT_ALIAS(led0) 
static const struct gpio_dt_spec led = GPIO_DT_SPEC_GET(LED0_NODE, gpios);

#define LOG_LEVEL CONFIG_LOG_DEFAULT_LEVEL
#include <zephyr/logging/log.h>
LOG_MODULE_REGISTER(app);

int main(void)
{
	printf("Hello World! %s\n", CONFIG_BOARD_TARGET);

	const struct device *display_dev;

	display_dev = DEVICE_DT_GET(DT_CHOSEN(zephyr_display));
	if (!device_is_ready(display_dev)) {
		LOG_ERR("Device not ready, aborting test");
		return 0;
	}

	lv_sample();

	gpio_pin_configure_dt(&led, GPIO_OUTPUT);
	gpio_pin_set(led.port, led.pin, 1);
	display_blanking_off(display_dev);

	while (1) {
		k_sleep(K_MSEC(10));
		lv_task_handler();
	}

	return 0;
}
```
